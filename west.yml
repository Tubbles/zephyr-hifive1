## west.yml
```yaml
# Single source of truth for which Zephyr (and modules) this project builds
# against. Bump `revision`, rebuild the image, done. This repo is itself the
# manifest repo (Zephyr "T2 / star topology" application).
manifest:
  remotes:
    - name: zephyrproject-rtos
      url-base: https://github.com/zephyrproject-rtos
  projects:
    - name: zephyr
      remote: zephyrproject-rtos
      revision: v4.4.1
      # Clone ONLY Zephyr, no modules: FE310 / HiFive1 support is entirely
      # in-tree and picolibc comes from the SDK toolchain
      # (CONFIG_PICOLIBC_USE_TOOLCHAIN), so nothing external is needed.
      # `west-commands` registers Zephyr's build/flash extension commands --
      # normally these ride in via `import:`, which we deliberately omit so west
      # does not fetch the ~40 module repos (all the HALs, fatfs, mbedTLS, ...).
      # To add a module later, replace the west-commands line with an import
      # that allowlists it:
      #     import:
      #       name-allowlist: [hal_foo]
      # Do NOT use an empty allowlist to mean "no modules": west reads `[]` as
      # "no filter" and imports everything.
      west-commands: scripts/west-commands.yml
  self:
    # The workspace topdir is the repo root; `make update` copies this file
    # into a generated, gitignored `.manifest/` git repo and runs
    # `west init -l .manifest`, so the checkouts (zephyr/, modules/, ...) land
    # alongside it under the repo. This path is relative to that topdir.
    path: .manifest
```
